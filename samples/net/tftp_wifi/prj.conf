## CMakeLists.txt
```
# SPDX-License-Identifier: Apache-2.0

cmake_minimum_required(VERSION 3.13.1)

include($ENV{ZEPHYR_BASE}/cmake/app/boilerplate.cmake NO_POLICY_SCOPE)
project(tftp_wifi)

target_sources(app PRIVATE src/main.c)
```

## prj.conf
```kconfig
CONFIG_NETWORKING=y
CONFIG_NET_SOCKETS=y
CONFIG_NET_TCP=y
CONFIG_NET_LOG=y

CONFIG_PRINTK=y
CONFIG_STDOUT_CONSOLE=y

# Enable IPv4 support
CONFIG_NET_IPV4=y

# Enable the MQTT Lib
CONFIG_MQTT_LIB=y

# Enable TFTP
CONFIG_TFTP_LIB=y

CONFIG_NET_CONFIG_SETTINGS=y

CONFIG_MAIN_STACK_SIZE=2048

# For IPv6
CONFIG_NET_BUF_DATA_SIZE=256

CONFIG_NET_SHELL=y
CONFIG_EARLY_CONSOLE=y

CONFIG_NETWORKING=y
CONFIG_TEST_RANDOM_GENERATOR=y

CONFIG_NET_TX_STACK_SIZE=2048
CONFIG_NET_RX_STACK_SIZE=2048

CONFIG_NET_PKT_RX_COUNT=10
CONFIG_NET_PKT_TX_COUNT=10
CONFIG_NET_BUF_RX_COUNT=20
CONFIG_NET_BUF_TX_COUNT=20
CONFIG_NET_MAX_CONTEXTS=10

CONFIG_NET_IPV4=y
CONFIG_NET_IPV6=n

CONFIG_NET_TCP=y

CONFIG_LOG=y
CONFIG_NET_LOG=y
CONFIG_INIT_STACKS=y

CONFIG_NET_SHELL=y

CONFIG_NET_STATISTICS=y
CONFIG_NET_STATISTICS_PERIODIC_OUTPUT=n

CONFIG_WIFI=y
CONFIG_WIFI_LOG_LEVEL_ERR=y
CONFIG_NET_L2_WIFI_SHELL=y

#CONFIG_NO_OPTIMIZATIONS=y

# Enabling WiFi as it is my default interface.
CONFIG_WIFI=y
CONFIG_WIFI_LOG_LEVEL_ERR=y
CONFIG_NET_L2_WIFI_SHELL=y
CONFIG_WIFI_OFFLOAD=y
CONFIG_NET_OFFLOAD=y
CONFIG_NET_L2_WIFI_MGMT=y

CONFIG_NO_OPTIMIZATIONS=y
```

## src/main.c
```c
/*
 * Copyright (c) 2012-2014 Wind River Systems, Inc.
 *
 * SPDX-License-Identifier: Apache-2.0
 */

#include <zephyr.h>
#include <sys/printk.h>

/* Support for Sockets. */
#include <net/socket.h>

/* Support for WiFi. */
#include <net/wifi_mgmt.h>
#include <net/net_event.h>

/* Support for TFTP. */
#include <net/tftp.h>

/* Hardcoded SSID / Password for now. Should be updated by the user per their config. */
#define MY_SSID     "GalaxyJ7"
#define PASS        "bilalwasim"

/* Hardcoded values for Server IP / Port. Should be updated by the user per their config. */
#define TFTPS_IP     "192.168.43.138"
#define TFTPS_PORT   51000

/* User buffer and structure for getting / putting data from / to the TFTP Server. */
static u8_t  buf[16384];
struct tftpc tmp_struct = {
	.user_buf      = (u8_t *) buf, /* Pointer to user buffer. */
	.user_buf_size = 16384         /* Size of the buffer. */
};


/* Function: WiFi_Setup
 * Description: This function tries to connect with a given SSID / Password pair.  */
static int32_t WiFi_Setup(void)
{
	/* Get the default network interface (which will be WiFi in our configuration). */
	struct net_if *iface = net_if_get_default();
	struct wifi_connect_req_params cnx_params = {0};

	/* Populate defaults. */
	cnx_params.ssid        = MY_SSID;
	cnx_params.ssid_length = strlen(MY_SSID);
	cnx_params.psk         = PASS;
	cnx_params.psk_length  = strlen(PASS);
	cnx_params.channel     = WIFI_CHANNEL_ANY;
	cnx_params.security    = WIFI_SECURITY_TYPE_PSK;

	/* Connect with the default "GalaxyJ7" SSID. */
	net_mgmt(NET_REQUEST_WIFI_CONNECT, iface, &cnx_params, sizeof(struct wifi_connect_req_params));

	/* Wait until connection is established with the given SSID. */
	return (net_mgmt_event_wait(NET_EVENT_WIFI_CONNECT_RESULT, NULL, &iface, NULL, NULL, K_FOREVER));
}

void main(void)
{
	int                ret;
	struct sockaddr_in server;

	/* Fill in the server info.
	 * - Use INET.
	 * - Use UDP Port  - TFTPS_PORT.
	 * - Use Server IP - TFTPS_IP. */
	server.sin_family = AF_INET;
	server.sin_port   = htons(TFTPS_PORT);
	inet_pton(AF_INET, TFTPS_IP, &server.sin_addr);

	/* Log message. */
	printk("Hello World! %s\n", CONFIG_BOARD);

	/* Lets setup WiFi. */
	WiFi_Setup();
	
	/* Lets get data from the TFTP Server. */
	ret = tftp_get(&server, &tmp_struct, "test", "octet");

	while (1);
}
```
