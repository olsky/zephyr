## CMakeLists.txt
```
cmake_minimum_required(VERSION 3.13.1)

include($ENV{ZEPHYR_BASE}/cmake/app/boilerplate.cmake NO_POLICY_SCOPE)
project(mesh_gateway)

target_sources(app PRIVATE
	src/main.c
	src/mqtt_publisher.c
	src/uart_mqtt_bridge.c
	src/board_lights.c
	src/net_mngr.c)
zephyr_include_directories(src)
```

## Kconfig
```
#
# Copyright (c) 2019 innblue
#

menu "Gateway-91 MQTT Settings"

config MQTT_PORT
	int "The Broker connection Port, defaults to 1883"
	default 1883
	depends on NET_CONFIG_SETTINGS

config MQTT_PUB_TOPIC
	string "The Broker topic name for publishing events from mesh"
	default "sensors"
	depends on NET_CONFIG_SETTINGS

config MQTT_SUB_TOPIC
	string "The Broker topic name for subscribing events to mesh"
	default "commands"
	depends on NET_CONFIG_SETTINGS

choice
	prompt "Mesage publisher Quality Of Service"
	default MQTT_QOS_0_AT_MOST_ONCE 

config MQTT_QOS_0_AT_MOST_ONCE
       bool "MQTT_QOS_0_AT_MOST_ONCE"

config MQTT_QOS_1_AT_LEAST_ONCE
       bool "MQTT_QOS_1_AT_LEAST_ONCE"

config MQTT_QOS_2_EXACTLY_ONCE
       bool "MQTT_QOS_2_EXACTLY_ONCE"

endchoice

config SYSTEM_STATE_THREAD_STACK_SIZE
	int
	prompt "System State thread stack size"
	default 512 if NO_OPTIMIZATIONS
	default 256
	help
	  Stack size for the System State thread.

config BLE_UART_NAME
	string "UART device name the BLE Mesh is connected to"

endmenu

menu "Zephyr Kernel"
source "$ZEPHYR_BASE/Kconfig.zephyr"
endmenu
```

## west.yml
```
# The west manifest file for the nRF Connect SDK (NCS).
#
# The per-installation west configuration file specifies the location of this
# manifest file. The "path" option in the [manifest] section of .west/config
# defines the folder that contains west.yml. The path is relative to the folder
# that contains .west.
#
# You can create your own manifest files and put them in any
# repository you want, to create your own custom NCS installation.
# For example, you could create a manifest file in your own
# out-of-tree application directory, which would pull the nrf repository
# in as an ordinary project.
#
# You can pass your manifest repositories to west init when creating a
# new NCS installation. See the west documentation for more
# information.

west:
  url: https://github.com/zephyrproject-rtos/west
  revision: v0.5.8

manifest:
  defaults:
    remote: ncs

  remotes:
      # nRF Connect SDK base URL.
    - name: ncs
      url-base: https://github.com/NordicPlayground
    - name: zephyrproject
      url-base: https://github.com/zephyrproject-rtos
    - name: throwtheswitch
      url-base: https://github.com/ThrowTheSwitch
    - name: armmbed
      url-base: https://github.com/ARMmbed
    - name: civetweb
      url-base: https://github.com/civetweb


  # The list of external projects for the nRF Connect SDK.
  #
  projects:
    - name: zephyr
      repo-path: fw-nrfconnect-zephyr
      west-commands: scripts/west-commands.yml
      revision: 9c3f95834f5c021a5c36db6f382a2cfdaff25c06
    - name: nffs
      revision: bc62a2fa9d98ddb5d633c932ea199bc68e10f194
      path: modules/fs/nffs
      remote: zephyrproject
    - name: segger
      revision: 6fcf61606d6012d2c44129edc033f59331e268bc
      path: modules/debug/segger
      remote: zephyrproject
    - name: mbedtls
      repo-path: fw-nrfconnect-mbedtls
      path: modules/crypto/mbedtls
      revision: c3be1b52f5e56aaba6039c423478cfaf62a91622
    - name: mcuboot
      repo-path: fw-nrfconnect-mcuboot
      revision: 3db81a20bc4617c435a89732ed3f3cbd122c3595
    - name: mcumgr
      repo-path: fw-nrfconnect-mcumgr
      revision: f663988d35da559a37f263d369842dbce309d1fa
      path: modules/lib/mcumgr
    - name: tinycbor
      repo-path: fw-nrfconnect-tinycbor
      path: modules/lib/tinycbor
      revision: 86d5ed5dd544b107d2d0882961a19c2c6cb06572
    - name: ci-tools
      path: tools/ci-tools
      remote: zephyrproject
      revision: e01f3bce2a94847253369efb9a081f5c0e9ec882
    - name: net-tools
      path: tools/net-tools
      remote: zephyrproject
      revision: 30b7efa827b04d2e47840716b0372737fe7d6c92
    - name: nrfxlib
      path: nrfxlib
      revision: a806f5fcac3bde98c4c7324a0c4d547b4ba89f75
    - name: cmock
      path: test/cmock
      revision: c243b9a7a7b3c471023193992b46cf1bd1910450
      remote: throwtheswitch
    - name: unity
      path: test/cmock/vendor/unity
      revision: 031f3bbe45f8adf504ca3d13e6f093869920b091
      remote: throwtheswitch
    - name: mbedtls-nrf
      path: mbedtls
      repo-path: mbedtls
      revision: mbedtls-2.16.3
      remote: armmbed

    # The projects below are included for completeness, but they are
    # not known to work properly with the NCS multi-image / partition
    # manager patchset. Please report any issues.
    #
    # https://developer.nordicsemi.com/nRF_Connect_SDK/doc/latest/nrf/scripts/partition_manager/partition_manager.html
    - name: civetweb
      path: modules/lib/civetweb
      remote: civetweb
      revision: 99129c5efc907ea613c4b73ccff07581feb58a7a
    - name: fatfs
      path: modules/fs/fatfs
      remote: zephyrproject
      revision: df96914dd989907f3a5de4cb95b116c2f305820d
    - name: hal_nordic
      path: modules/hal/nordic
      remote: zephyrproject
      revision: 1b14177ff2176a1d17f3dd5e7e217f44337255db
    - name: hal_st
      path: modules/hal/st
      remote: zephyrproject
      revision: 0ec40aed8087f26bd9ac1b70fb5a6c326a6451aa
    - name: libmetal
      path: modules/hal/libmetal
      remote: zephyrproject
      revision: 45e630d6152824f807d3f919958605c4626cbdff
    - name: lvgl
      path: modules/lib/gui/lvgl
      remote: zephyrproject
      revision: d4708d0a432e95f51bdc712591ba5295b751140c
    - name: open-amp
      path: modules/lib/open-amp
      remote: zephyrproject
      revision: 9b591b289e1f37339bd038b5a1f0e6c8ad39c63a
    - name: openthread
      path: modules/lib/openthread
      remote: zephyrproject
      revision: 3c32244f098f8daf8741efe0a2ad839b67f8567f
    - name: littlefs
      path: modules/fs/littlefs
      remote: zephyrproject
      revision: fe9572dd5a9fcf93a249daa4233012692bd2881d
    - name: nrf
      revision: v1.1.0-rc2
      url: https://github.com/NordicPlayground/fw-nrfconnect-nrf
      west-commands: scripts/west-commands.yml
      
  self:
    path: inn-gw-ble-demo2
```

## prj.conf
```kconfig
# General config
CONFIG_GPIO=y
CONFIG_REBOOT=y
CONFIG_ASSERT=n

# Serial
CONFIG_SERIAL=y
CONFIG_GPIO=y
CONFIG_UART_LINE_CTRL=y

# enable console
CONFIG_CONSOLE=y
CONFIG_UART_CONSOLE=n
CONFIG_PRINTK=y
CONFIG_USE_SEGGER_RTT=y
CONFIG_RTT_CONSOLE=y
CONFIG_LOG_BACKEND_RTT=y
CONFIG_LOG_BACKEND_UART=n
CONFIG_LOG_IMMEDIATE=y

# Heap and stacks
# Main thread
CONFIG_MAIN_STACK_SIZE=4096
CONFIG_SYSTEM_WORKQUEUE_STACK_SIZE=2048

# Enable the MQTT Lib
CONFIG_MQTT_LIB=y
CONFIG_NET_CONFIG_SETTINGS=y
CONFIG_MQTT_PORT=1883
# Pub and sub topics: %s replaced with EMEI of the device, 
# max. len. 128 symbols + IMEI
CONFIG_MQTT_SUB_TOPIC="/innblue/mesh/commands/%s"
CONFIG_MQTT_PUB_TOPIC="/innblue/mesh/gateway/%s"
CONFIG_NET_LOG=y
CONFIG_MQTT_QOS_1_AT_LEAST_ONCE=y
CONFIG_MQTT_KEEPALIVE=120

# UART device which interfaces with BLE Mesh
CONFIG_BLE_UART_NAME="UART_1"
```

## overlay-net-offload.conf
```kconfig
CONFIG_MODEM_SHELL=n
CONFIG_SEGGER_RTT_PRINTF_BUFFER_SIZE=128
CONFIG_SEGGER_RTT_MODE_NO_BLOCK_SKIP=y

CONFIG_LOG_IMMEDIATE=n
CONFIG_LOG_BACKEND_RTT=y
CONFIG_LOG_PRINTK_MAX_STRING_LENGTH=128
CONFIG_LOG_MODE_OVERFLOW=y
CONFIG_LOG_BUFFER_SIZE=1024
CONFIG_LOG_DETECT_MISSED_STRDUP=y
CONFIG_LOG_STRDUP_MAX_STRING=128
CONFIG_LOG_STRDUP_BUF_COUNT=16

CONFIG_NET_CONFIG_SETTINGS=y
CONFIG_NET_CONFIG_MY_IPV6_ADDR=""
CONFIG_NET_CONFIG_PEER_IPV6_ADDR=""
CONFIG_NET_CONFIG_MY_IPV4_ADDR=""
CONFIG_NET_CONFIG_PEER_IPV4_ADDR="35.158.15.231"
CONFIG_MQTT_PORT=18830
CONFIG_MQTT_KEEPALIVE=120

CONFIG_MODEM_GSM_PPP=n
CONFIG_MODEM_GSM_UART_NAME=""
CONFIG_NET_PPP=n
CONFIG_NET_L2_PPP=n
CONFIG_MODEM_SOCKET=y
CONFIG_MODEM_SOCKET_PACKET_COUNT=6
CONFIG_MODEM_SIM800=y
CONFIG_MODEM_SIM80X_NAME="MODEM_SIM80X"
CONFIG_MODEM_SIM80X_APN="iot.1nce.net"
CONFIG_MODEM_SIM80X_INIT_PRIORITY=50
CONFIG_NEWLIB_LIBC=y
CONFIG_NEWLIB_LIBC_NANO=y
CONFIG_NET_OFFLOAD=y
CONFIG_NET_OFFLOAD_LOG_LEVEL_DEFAULT=y
CONFIG_NET_SOCKETS_OFFLOAD=y

CONFIG_SHELL=n
CONFIG_NET_SHELL=n
```

## overlay-ppp.conf
```kconfig
# GSM modem support
CONFIG_MODEM=y
CONFIG_MODEM_GSM_PPP=y
CONFIG_MODEM_GSM_UART_NAME="UART_4"
CONFIG_MODEM_GSM_APN="internet"

# PPP networking support
CONFIG_NET_PPP=y
CONFIG_NET_L2_PPP=y
CONFIG_NET_NATIVE=y
CONFIG_NETWORKING=y
CONFIG_NET_DEFAULT_IF_PPP=y

# NET Stack support
CONFIG_NET_L2_PPP_TIMEOUT=10000
CONFIG_NET_IPV4=y
CONFIG_NET_IPV6=n
CONFIG_NET_TCP=y
CONFIG_NET_TCP1=y
CONFIG_NET_TCP_CHECKSUM=y
CONFIG_NET_TCP_TIME_WAIT_DELAY=250
CONFIG_NET_TCP_ACK_TIMEOUT=1000
CONFIG_NET_TCP_INIT_RETRANSMISSION_TIMEOUT=200
CONFIG_NET_TCP_RETRY_COUNT=9
CONFIG_NET_UDP=y
CONFIG_NET_CONNECTION_MANAGER=y
CONFIG_NET_PKT_RX_COUNT=25

# Logging / Shell support
CONFIG_LOG=y
CONFIG_NET_LOG=y
#CONFIG_LOG_BUFFER_SIZE=16384
#CONFIG_LOG_STRDUP_BUF_COUNT=200
CONFIG_MODEM_LOG_LEVEL_DBG=y
CONFIG_NET_SHELL=y
CONFIG_MODEM_SHELL=y

# Net settings (only the MQTT Broker address matters)
# All else must be empty
CONFIG_NET_CONFIG_SETTINGS=y
CONFIG_NET_CONFIG_MY_IPV6_ADDR=""
CONFIG_NET_CONFIG_PEER_IPV6_ADDR=""
CONFIG_NET_CONFIG_MY_IPV4_ADDR=""
CONFIG_NET_CONFIG_PEER_IPV4_ADDR="5.196.95.208"

# Additional buffers for PPP.
CONFIG_NET_PKT_RX_COUNT=16
CONFIG_NET_PKT_TX_COUNT=16
CONFIG_NET_BUF_RX_COUNT=64
CONFIG_NET_BUF_TX_COUNT=64
```

## boards/nrf9160_pca10090ns.conf
```kconfig
# need a cleanup here
CONFIG_UART_SERIAL_MESH=2
CONFIG_UART_2_NRF_UARTE=y
CONFIG_UART_2_NRF_FLOW_CONTROL=y
```

## boards/nrf9160_pca20035ns.conf
```kconfig
CONFIG_UART_SERIAL_MESH=1
CONFIG_UART_1_NRF_UARTE=y
CONFIG_UART_1_NRF_FLOW_CONTROL=y
```

## src/main.c
```c
#include <logging/log.h>
LOG_MODULE_REGISTER(mesh_gateway, 3);

#include <zephyr.h>
#include <sys/printk.h>
#include <stdint.h>
#include <logging/log_ctrl.h>
#include <net/tls_credentials.h>
#include <net/socket.h>
#include <power/reboot.h>
#include <drivers/gpio.h>

/* App header files. */
#include "mqtt_publisher.h"
#include "uart_mqtt_bridge.h"
#include "board_lights.h"
#include "config.h"
#include "net_mngr.h"

/* System main thread. */
void main(void)
{
	const char *build_str = "" __DATE__ " " __TIME__;
	printk("innblue > mqtt broker > mqtt-nrf91-nrf52-mesh\n");
	printk("innblue > %s [%d] > built: %s\n", __func__, __LINE__, build_str);

	/* Blink LEDs. */
	board_lights.blink_mqtt(2);
	board_lights.blink_uart(2);
	board_lights.modem_connected(false);

	int net_wait_seconds = 120;
	while (net_wait_seconds && !net_mngr.is_network_ready()) {
		k_sleep(K_SECONDS(1));
		net_wait_seconds--;
	}

	if (net_mngr.is_network_ready() &&
		mqtt_publisher.initialize(net_mngr.get_guid())) 
		board_lights.modem_connected(true);
	else
		net_mngr.restart();
	

	/* Set up serial link to BLE Mesh. */
	printk("Setting up serial link to Bluetooth mesh...\n");
	uart_mqtt_bridge.start(CONFIG_BLE_UART_NAME, mqtt_publisher.publish);
	mqtt_publisher.set_subscribe_callback(uart_mqtt_bridge.write_to_uart);

	printk("connect to MQTT and start processing...\n");

	while (1) {
		if (!mqtt_publisher.process_input())
			net_mngr.restart();

		k_sleep(K_SECONDS(1));
	}
}

/**@brief Fatal error handler */
void k_sys_fatal_error_handler(unsigned int reason,
					const z_arch_esf_t *esf)
{
	ARG_UNUSED(esf);
	LOG_PANIC();
	LOG_ERR("Fatal error, the system is being restarted. Bye for now!");
	sys_reboot(SYS_REBOOT_COLD);
	CODE_UNREACHABLE;
}
```

## src/board_lights.c
```c
#include "board_lights.h"
#include <device.h>
#include <drivers/gpio.h>
#include <zephyr.h>

#ifdef CONFIG_BOARD_NRF9160_PCA10090NS
	#define LED_PORT	       "GPIO_0" //DT_ALIAS_LED0_GPIOS_CONTROLLER
	#define LED_MODEM_CTRL     LED_PORT
	#define LED_RECONNECT_CTRL LED_PORT
	#define LED_MQTT_CTRL      LED_PORT
	#define LED_UART_CTRL      LED_PORT
	// LTE modem led
	#define LED_MODEM DT_ALIAS_LED0_GPIOS_PIN
	// reconnect
	#define LED_RECONNECT DT_ALIAS_LED1_GPIOS_PIN
	// mqtt activity
	#define LED_MQTT DT_ALIAS_LED2_GPIOS_PIN
	// uart activity
	#define LED_UART DT_ALIAS_LED3_GPIOS_PIN
#elif defined(CONFIG_BOARD_NRF9160_PCA20035NS)
    #define LED_PORT	       "GPIO_0" //DT_ALIAS_LED0_GPIOS_CONTROLLER
	#define LED_MODEM_CTRL     LED_PORT
	#define LED_RECONNECT_CTRL LED_PORT
	#define LED_MQTT_CTRL      LED_PORT
	#define LED_UART_CTRL      LED_PORT
	// LTE modem led
	#define LED_MODEM DT_ALIAS_LED0_GPIOS_PIN
	// reconnect
	#define LED_RECONNECT DT_ALIAS_LED1_GPIOS_PIN
	// mqtt activity
	#define LED_MQTT DT_ALIAS_LED2_GPIOS_PIN
	// uart activity
	#define LED_UART DT_ALIAS_LED2_GPIOS_PIN
#elif defined(CONFIG_BOARD_DISCO_L475_IOT1)
	#define LED_MODEM_CTRL     DT_ALIAS_LED0_GPIOS_CONTROLLER
	#define LED_MQTT_CTRL      DT_ALIAS_LED1_GPIOS_CONTROLLER
	#define LED_UART_CTRL      DT_ALIAS_LED1_GPIOS_CONTROLLER
	// LTE modem led
	#define LED_MODEM DT_ALIAS_LED0_GPIOS_PIN
	// mqtt activity
	#define LED_MQTT DT_ALIAS_LED1_GPIOS_PIN
	// uart activity
	#define LED_UART DT_ALIAS_LED1_GPIOS_PIN
#elif defined(CONFIG_BOARD_SKYYGATE_SIM868)
	#define LED_MODEM_CTRL     DT_GPIO_LEDS_LED0_GPIOS_CONTROLLER
	#define LED_RECONNECT_CTRL DT_GPIO_LEDS_LED1_GPIOS_CONTROLLER
	#define LED_MQTT_CTRL      DT_GPIO_LEDS_LED2_GPIOS_CONTROLLER
	#define LED_UART_CTRL      DT_GPIO_LEDS_LED3_GPIOS_CONTROLLER
	// LTE modem led
	#define LED_MODEM     DT_ALIAS_LED0_GPIOS_PIN
	// reconnect
	#define LED_RECONNECT DT_ALIAS_LED1_GPIOS_PIN
	// mqtt activity
	#define LED_MQTT      DT_ALIAS_LED2_GPIOS_PIN
	// uart activity
	#define LED_UART      DT_ALIAS_LED3_GPIOS_PIN
#endif


#define BLINK_DURATION_MS (K_MSEC(250))

static K_THREAD_STACK_DEFINE(thread_stack, CONFIG_SYSTEM_STATE_THREAD_STACK_SIZE);
static struct k_thread thread_data;

K_MUTEX_DEFINE(led_modem_mutex);

//static struct device *dev;
struct led {
	struct device *dev;
	u32_t pin;
	u32_t blinks_left;
};

static struct led led_uart = {
	.pin = LED_UART,
	.blinks_left = 0
};

static struct led led_mqtt = {
	.pin = LED_MQTT,
	.blinks_left = 0
};

static struct led led_modem = {
	.pin = LED_MODEM,
	.blinks_left = 0
};

static void blink_down(struct led *light) {
	if (!light->blinks_left)
		return;

	if (light->blinks_left % 2 == 0)
		gpio_pin_set(light->dev, light->pin, 1);
	else
		gpio_pin_set(light->dev, light->pin, 0);

	light->blinks_left--;
}

static void blink_forever(struct led *light, struct k_mutex *mutex) {
	if (!light->blinks_left)
		return;

	k_mutex_lock(mutex, K_FOREVER);
	if (!light->blinks_left)
		goto exit;

	if (light->blinks_left % 2) {
		gpio_pin_set(light->dev, light->pin, 1);
		light->blinks_left = 2;
	}
	else {
		gpio_pin_set(light->dev, light->pin, 0);
		light->blinks_left = 1;
	}

exit:
	k_mutex_unlock(mutex);
}

static void state_thread(void *p1, void *p2, void *p3)
{
	while(1) {
		blink_down(&led_mqtt);
		blink_down(&led_uart);
		blink_forever(&led_modem, &led_modem_mutex);
		k_sleep(BLINK_DURATION_MS);
	}
}

static void initialise() {
	static bool initialised = false;

	if (initialised)
		return;
	

	// set device
	led_uart.dev  = device_get_binding(LED_UART_CTRL);
	led_mqtt.dev  = device_get_binding(LED_MQTT_CTRL);
	led_modem.dev = device_get_binding(LED_MODEM_CTRL);


	/* Set LED pin as output */
	gpio_pin_configure(led_modem.dev, LED_MODEM, GPIO_OUTPUT);
	//gpio_pin_configure(dev, LED_RECONNECT, GPIO_OUTPUT);
	gpio_pin_configure(led_uart.dev, LED_UART, GPIO_OUTPUT);
	gpio_pin_configure(led_mqtt.dev, LED_MQTT, GPIO_OUTPUT);

	k_thread_create(&thread_data, thread_stack,
		K_THREAD_STACK_SIZEOF(thread_stack), state_thread,
		NULL, NULL, NULL, K_PRIO_COOP(9), 0, K_NO_WAIT);

	initialised = true;
}

static void blink_mqtt (u16_t blinks) {
	initialise();
	if (led_mqtt.blinks_left == 0)
		led_mqtt.blinks_left = blinks * 2;
}

static void blink_uart (u16_t blinks) {
	initialise();
	if (led_uart.blinks_left == 0)
		led_uart.blinks_left = blinks * 2;
}

static void modem_connected (bool connected)
{
	initialise();
	if (connected) {
		k_mutex_lock(&led_modem_mutex, K_FOREVER);
		led_modem.blinks_left = 0;
		k_mutex_unlock(&led_modem_mutex);
		gpio_pin_set(led_modem.dev, led_modem.pin, 1);
	} else {
		k_mutex_lock(&led_modem_mutex, K_FOREVER);
		led_modem.blinks_left = 1;
		k_mutex_unlock(&led_modem_mutex);
	}
}

const board_lights_t board_lights = {
	.blink_mqtt = blink_mqtt,
	.blink_uart = blink_uart,
	.modem_connected = modem_connected
};
```

## src/board_lights.h
```c
#ifndef BOARD_LIGHTS_H
#define BOARD_LIGHTS_H
#include <zephyr/types.h>
#include <stdbool.h>

typedef struct {
	void (*blink_uart) (u16_t blinks);
	void (*blink_mqtt) (u16_t blinks);
	void (*modem_connected) (bool connected);
} board_lights_t;

extern const board_lights_t board_lights;

#endif
```

## src/config.h
```c
/*
 * Copyright (c) 2017 Intel Corporation
 *
 * SPDX-License-Identifier: Apache-2.0
 */

#ifndef __CONFIG_H__
#define __CONFIG_H__

#include <net/mqtt.h>


#ifdef CONFIG_NET_CONFIG_SETTINGS
#ifdef CONFIG_NET_IPV6
#define ZEPHYR_ADDR		CONFIG_NET_CONFIG_MY_IPV6_ADDR
#define SERVER_ADDR		CONFIG_NET_CONFIG_PEER_IPV6_ADDR
#else
#define ZEPHYR_ADDR		CONFIG_NET_CONFIG_MY_IPV4_ADDR
#define SERVER_ADDR		CONFIG_NET_CONFIG_PEER_IPV4_ADDR
#endif
#define SERVER_PORT             CONFIG_MQTT_PORT
#else
#ifdef CONFIG_NET_IPV6
#define ZEPHYR_ADDR		"2001:db8::1"
#define SERVER_ADDR		"2001:db8::2"
#else
#define ZEPHYR_ADDR		"192.168.1.101"
#define SERVER_ADDR		"5.196.95.208"
#endif
#endif

#if defined(CONFIG_SOCKS)
#define SOCKS5_PROXY_ADDR	SERVER_ADDR
#define SOCKS5_PROXY_PORT	1080
#endif

#ifdef CONFIG_MQTT_LIB_TLS
#ifdef CONFIG_MQTT_LIB_WEBSOCKET
#define SERVER_PORT		9001
#else
#define SERVER_PORT		8883
#endif /* CONFIG_MQTT_LIB_WEBSOCKET */
#else
#ifdef CONFIG_MQTT_LIB_WEBSOCKET
#define SERVER_PORT		9001
#else
#ifndef SERVER_PORT
#define SERVER_PORT		1883 //default TCP host value
#endif
#endif /* CONFIG_MQTT_LIB_WEBSOCKET */
#endif

#define APP_SLEEP_MSECS		3000
#define APP_TX_RX_TIMEOUT       300
#define APP_NET_INIT_TIMEOUT    10000


#define APP_CONNECT_TRIES	3

#define APP_MAX_ITERATIONS	100

#define APP_MQTT_BUFFER_SIZE	256

#define PUB_RETRY_TIMEOUT_MSECS 5000

#ifdef CONFIG_MQTT_QOS_0_AT_MOST_ONCE
#define MQTT_QOS MQTT_QOS_0_AT_MOST_ONCE
#endif
#ifdef CONFIG_MQTT_QOS_1_AT_LEAST_ONCE
#define MQTT_QOS MQTT_QOS_1_AT_LEAST_ONCE
#endif
#ifdef CONFIG_MQTT_QOS_2_EXACTLY_ONCE
#define MQTT_QOS MQTT_QOS_2_EXACTLY_ONCE
#endif


#endif
```

## src/mqtt_publisher.c
```c
/*
 * Copyright (c) 2017 Intel Corporation
 *
 * SPDX-License-Identifier: Apache-2.0
 */

#include <assert.h>
#include "board_lights.h"
#include <logging/log.h>
LOG_MODULE_REGISTER(mqtt_publisher, LOG_LEVEL_DBG);

#include <zephyr.h>
#include <net/socket.h>
#include <net/mqtt.h>

#include <stdio.h>
#include <string.h>
#include <errno.h>

#include "config.h"
#include "mqtt_publisher.h"

/* MQTT-3.1.3-5 spec */
#define CLIENT_ID_MAX_LENGTH (23) 
static u8_t client_id_buf[CLIENT_ID_MAX_LENGTH+1];
static u8_t publish_topic[256];
static u8_t subscription_topic[256];

/* Buffers for MQTT client. */
static u8_t rx_buffer[APP_MQTT_BUFFER_SIZE];
static u8_t tx_buffer[APP_MQTT_BUFFER_SIZE];

K_SEM_DEFINE(sem_puback, 0, 1);
static u16_t pub_msg_id = 0;

#if defined(CONFIG_MQTT_LIB_WEBSOCKET)
/* Making RX buffer large enough that the full IPv6 packet can fit into it */
#define MQTT_LIB_WEBSOCKET_RECV_BUF_LEN 1280

/* Websocket needs temporary buffer to store partial packets */
static u8_t temp_ws_rx_buf[MQTT_LIB_WEBSOCKET_RECV_BUF_LEN];
#endif

/* The mqtt client struct */
static struct mqtt_client client_ctx;

/* MQTT Broker details. */
static struct sockaddr_storage broker;

#if defined(CONFIG_SOCKS)
static struct sockaddr socks5_proxy;
#endif

static struct pollfd fds[1];
static int nfds;

static bool connected;

#if defined(CONFIG_MQTT_LIB_TLS)

#include "test_certs.h"

#define TLS_SNI_HOSTNAME "localhost"
#define APP_CA_CERT_TAG 1
#define APP_PSK_TAG 2


static sec_tag_t m_sec_tags[] = {
#if defined(MBEDTLS_X509_CRT_PARSE_C) || defined(CONFIG_NET_SOCKETS_OFFLOAD)
		APP_CA_CERT_TAG,
#endif
#if defined(MBEDTLS_KEY_EXCHANGE__SOME__PSK_ENABLED)
		APP_PSK_TAG,
#endif
};

static int tls_init(void)
{
	int err = -EINVAL;

#if defined(MBEDTLS_X509_CRT_PARSE_C) || defined(CONFIG_NET_SOCKETS_OFFLOAD)
	err = tls_credential_add(APP_CA_CERT_TAG, TLS_CREDENTIAL_CA_CERTIFICATE,
				 ca_certificate, sizeof(ca_certificate));
	if (err < 0) {
		LOG_ERR("Failed to register public certificate: %d", err);
		return err;
	}
#endif

#if defined(MBEDTLS_KEY_EXCHANGE__SOME__PSK_ENABLED)
	err = tls_credential_add(APP_PSK_TAG, TLS_CREDENTIAL_PSK,
				 client_psk, sizeof(client_psk));
	if (err < 0) {
		LOG_ERR("Failed to register PSK: %d", err);
		return err;
	}

	err = tls_credential_add(APP_PSK_TAG, TLS_CREDENTIAL_PSK_ID,
				 client_psk_id, sizeof(client_psk_id) - 1);
	if (err < 0) {
		LOG_ERR("Failed to register PSK ID: %d", err);
	}
#endif

	return err;
}

#endif /* CONFIG_MQTT_LIB_TLS */

static void prepare_fds(struct mqtt_client *client)
{
	if (client->transport.type == MQTT_TRANSPORT_NON_SECURE) {
		fds[0].fd = client->transport.tcp.sock;
	}
#if defined(CONFIG_MQTT_LIB_TLS)
	else if (client->transport.type == MQTT_TRANSPORT_SECURE) {
		fds[0].fd = client->transport.tls.sock;
	}
#endif

	fds[0].events = ZSOCK_POLLIN;
	nfds = 1;
}

static void clear_fds(void)
{
	nfds = 0;
}

#ifndef CONFIG_MODEM_SIM800
static void poll_when_transport_avail(int timeout_ms)
{
	if (!nfds) {
		k_sleep(K_MSEC(timeout_ms));
		return;
	}

	if (poll(fds, nfds, timeout_ms) < 0) 
		LOG_ERR("poll error: %d", errno);
}
#endif

subscribe_cb_t m_subscribe_cb = NULL;

static void mqtt_evt_handler(struct mqtt_client *const client,
			const struct mqtt_evt *evt)
{
	int err;

	switch (evt->type) {
	case MQTT_EVT_CONNACK:
		if (evt->result != 0) {
			LOG_ERR("MQTT connect failed %d\n", evt->result);
			break;
		}

		connected = true;
		LOG_INF("MQTT client connected!\n");

		break;

	case MQTT_EVT_DISCONNECT:
		LOG_INF("MQTT client disconnected %d\n", evt->result);

		connected = false;
		clear_fds();

		break;

	case MQTT_EVT_PUBACK:
		if (evt->result != 0) {
			LOG_ERR("MQTT PUBACK error %d\n", evt->result);
			break;
		}

		if (pub_msg_id == evt->param.puback.message_id) {
			LOG_INF("PUBACK: msgid %u matched.", 
				evt->param.puback.message_id);
			k_sem_give(&sem_puback);
		} else {
			LOG_ERR("PUBACK: msgid %u received, %u expected.", 
				evt->param.puback.message_id,
				pub_msg_id);
		}
		break;

	case MQTT_EVT_PUBREC:
		if (evt->result != 0) {
			LOG_ERR("MQTT PUBREC error %d", evt->result);
			break;
		}

		LOG_INF("PUBREC packet id: %u", evt->param.pubrec.message_id);

		const struct mqtt_pubrel_param rel_param = {
			.message_id = evt->param.pubrec.message_id
		};

		err = mqtt_publish_qos2_release(client, &rel_param);
		if (err != 0) {
			LOG_ERR("Failed to send MQTT PUBREL: %d", err);
		}

		break;

	case MQTT_EVT_PUBCOMP:
		if (evt->result != 0) {
			LOG_ERR("MQTT PUBCOMP error %d", evt->result);
			break;
		}

		LOG_INF("PUBCOMP packet id: %u",
			evt->param.pubcomp.message_id);

		break;

	case MQTT_EVT_PUBLISH:
		if (evt->result != 0) {
			LOG_ERR("MQTT PUBLISH error %d\n", evt->result);
			break;
		}

		u8_t d[33];
		int len = evt->param.publish.message.payload.len;
		int bytes_read;

		if (evt->param.publish.message.topic.qos 
			> MQTT_QOS_0_AT_MOST_ONCE) 
			LOG_INF("MsgId: %d, QoS: %d, bytes: %u",
				evt->param.publish.message_id,
			  	evt->param.publish.message.topic.qos,
			  	len);
		else
			LOG_INF("Msg with QoS: 0, bytes: %u", len);

		/* assuming the config message is textual */
		while (len > 0) {
			bytes_read = mqtt_read_publish_payload(
							&client_ctx, d,
							len >= 32 ? 32 : len);
			if (-EAGAIN == bytes_read) {
				k_yield();
				continue;
			}
			
			if (bytes_read < 0) {
				LOG_ERR("Failure to read payload");
				break;
			}

			d[bytes_read] = '\0';
			LOG_INF("   payload: %s", log_strdup(d));
			if (m_subscribe_cb)
				m_subscribe_cb(d);

			len -= bytes_read;
		}

		/* Acknowledge only when QoS requires and hence message id 
		 * is present.                                              */
		if (evt->param.publish.message.topic.qos 
			> MQTT_QOS_0_AT_MOST_ONCE) {
			struct mqtt_puback_param puback;
			puback.message_id = evt->param.publish.message_id;
			mqtt_publish_qos1_ack(&client_ctx, &puback);
		}
		break;

	case MQTT_EVT_PINGRESP:
		LOG_INF("MQTT ping response received."); 
		break;

	case MQTT_EVT_SUBACK:
		LOG_INF("MQTT subscription acknowledged.");
		break;	

	default:
		LOG_INF("MQTT event received %d", evt->type);
		break;
	}
}

static int publish(struct mqtt_client *client, 
		char *payload, 
		u16_t msg_id, 
		bool is_duplicate)
{
	struct mqtt_publish_param param;

	param.message.topic.qos = MQTT_QOS;
	param.message.topic.topic.utf8 = publish_topic;
	param.message.topic.topic.size =
			strlen(param.message.topic.topic.utf8);
	param.message.payload.data = payload;
	param.message.payload.len =
			strlen(param.message.payload.data);
	param.message_id = msg_id;
	param.dup_flag = is_duplicate;
	param.retain_flag = 0U;

	return mqtt_publish(client, &param);
}

#define RC_STR(rc) ((rc) == 0 ? "OK" : "ERROR")

#define PRINT_RESULT(func, rc) \
	LOG_INF("%s: %d <%s>", (func), rc, log_strdup(RC_STR(rc)))

static void broker_init(void)
{
#if defined(CONFIG_NET_IPV6)
	struct sockaddr_in6 *broker6 = (struct sockaddr_in6 *)&broker;

	broker6->sin6_family = AF_INET6;
	broker6->sin6_port = htons(SERVER_PORT);
	inet_pton(AF_INET6, SERVER_ADDR, &broker6->sin6_addr);

#if defined(CONFIG_SOCKS)
	struct sockaddr_in6 *proxy6 = (struct sockaddr_in6 *)&socks5_proxy;

	proxy6->sin6_family = AF_INET6;
	proxy6->sin6_port = htons(SOCKS5_PROXY_PORT);
	inet_pton(AF_INET6, SOCKS5_PROXY_ADDR, &proxy6->sin6_addr);
#endif
#else
	struct sockaddr_in *broker4 = (struct sockaddr_in *)&broker;

	broker4->sin_family = AF_INET;
	broker4->sin_port = htons(SERVER_PORT);
	inet_pton(AF_INET, SERVER_ADDR, &broker4->sin_addr);
#if defined(CONFIG_SOCKS)
	struct sockaddr_in *proxy4 = (struct sockaddr_in *)&socks5_proxy;

	proxy4->sin_family = AF_INET;
	proxy4->sin_port = htons(SOCKS5_PROXY_PORT);
	inet_pton(AF_INET, SOCKS5_PROXY_ADDR, &proxy4->sin_addr);
#endif
#endif
}

static int init_client_id(const char *client_id) 
{
	if (!client_id) {
		LOG_ERR("MQTT: provide client_id.");
		return EINVAL;
	}
	
	const size_t len = strlen(client_id);
	if (len < 1 || len > CLIENT_ID_MAX_LENGTH) {
		LOG_ERR("MQTT: client_id is either blank or over "  
			STRINGIFY(CLIENT_ID_MAX_LENGTH) 
			" symbols, see MQTT Spec MQTT-3.1.3-5.");
		return EINVAL;
	}

	for (const char *c = client_id; *c; c++)
		if ((*c < '0' || *c > '9') && 
			(*c < 'a' || *c > 'z') && 
			(*c < 'A' || *c > 'Z')) {
			LOG_ERR("MQTT: client_id '%s' has invalid characters, "
				"see MQTT Spec MQTT-3.1.3-5.",
				log_strdup(client_id));
			return  EINVAL;	
		}
		
	strncpy(client_id_buf, client_id, sizeof client_id_buf);

	if (sizeof(publish_topic) <= snprintf(publish_topic, 
			sizeof(publish_topic),
			CONFIG_MQTT_PUB_TOPIC, 
			client_id)) {
		LOG_ERR("MQTT: publish topic is too long.");  
		return EINVAL;
	}

	if (sizeof(subscription_topic) <= snprintf(subscription_topic, 
			sizeof(subscription_topic),
			CONFIG_MQTT_SUB_TOPIC, 
			client_id)) {
		LOG_ERR("MQTT: subscription topic is too long.");  
		return EINVAL;
	}
		
	LOG_INF("Pub-topic: %s", log_strdup(publish_topic));
	LOG_INF("Sub-topic: %s", log_strdup(subscription_topic));
	LOG_INF("MQTT Client Id: %s", log_strdup(client_id_buf));

	return 0;
}

static void client_init(struct mqtt_client *client)
{
	mqtt_client_init(client);

	broker_init();

	/* MQTT client configuration */
	client->broker = &broker;
	client->evt_cb = mqtt_evt_handler;
	// will get it in the initialize...
	client->client_id.utf8 = (u8_t *)client_id_buf; //MQTT_CLIENTID;
	client->client_id.size = strlen(client_id_buf); //MQTT_CLIENTID);
	client->password = NULL;
	client->user_name = NULL;
	client->protocol_version = MQTT_VERSION_3_1_1;

	/* MQTT buffers configuration */
	client->rx_buf = rx_buffer;
	client->rx_buf_size = sizeof(rx_buffer);
	client->tx_buf = tx_buffer;
	client->tx_buf_size = sizeof(tx_buffer);

	/* MQTT transport configuration */
#if defined(CONFIG_MQTT_LIB_TLS)
#if defined(CONFIG_MQTT_LIB_WEBSOCKET)
	client->transport.type = MQTT_TRANSPORT_SECURE_WEBSOCKET;
#else
	client->transport.type = MQTT_TRANSPORT_SECURE;
#endif

	struct mqtt_sec_config *tls_config = &client->transport.tls.config;

	tls_config->peer_verify = 2;
	tls_config->cipher_list = NULL;
	tls_config->sec_tag_list = m_sec_tags;
	tls_config->sec_tag_count = ARRAY_SIZE(m_sec_tags);
#if defined(MBEDTLS_X509_CRT_PARSE_C) || defined(CONFIG_NET_SOCKETS_OFFLOAD)
	tls_config->hostname = TLS_SNI_HOSTNAME;
#else
	tls_config->hostname = NULL;
#endif

#else
#if defined(CONFIG_MQTT_LIB_WEBSOCKET)
	client->transport.type = MQTT_TRANSPORT_NON_SECURE_WEBSOCKET;
#else
	client->transport.type = MQTT_TRANSPORT_NON_SECURE;
#endif
#endif

#if defined(CONFIG_MQTT_LIB_WEBSOCKET)
	client->transport.websocket.config.host = SERVER_ADDR;
	client->transport.websocket.config.url = "/mqtt";
	client->transport.websocket.config.tmp_buf = temp_ws_rx_buf;
	client->transport.websocket.config.tmp_buf_len =
						sizeof(temp_ws_rx_buf);
	client->transport.websocket.timeout = K_SECONDS(5);
#endif

#if defined(CONFIG_SOCKS)
	mqtt_client_set_proxy(client, &socks5_proxy,
			      socks5_proxy.sa_family == AF_INET ?
			      sizeof(struct sockaddr_in) :
			      sizeof(struct sockaddr_in6));
#endif
}

static bool mqtt_sub(void)
{
	LOG_INF("trying to subscribe to %s", log_strdup(subscription_topic));
	struct mqtt_topic subscribe_topics[] = {
		{
			.topic = {
				.utf8 = subscription_topic,
				.size = strlen(subscription_topic)
			},
			.qos = MQTT_QOS_0_AT_MOST_ONCE
		}
	};

	const struct mqtt_subscription_list subscription_list = {
		.list = subscribe_topics,
		.list_count = ARRAY_SIZE(subscribe_topics),
		.message_id = sys_rand32_get()
	};

	int rc = mqtt_subscribe(&client_ctx, &subscription_list);
	PRINT_RESULT("try_to_subscribe", rc);
	return 0 == rc;
}

/* In this routine we block until the connected variable is 1 */
static int try_to_connect(struct mqtt_client *client)
{
	int rc, i = 0;

	while (i++ < APP_CONNECT_TRIES && !connected) {

		client_init(client);

		rc = mqtt_connect(client);
		if (rc != 0) {
			PRINT_RESULT("mqtt_connect", rc);
			k_sleep(K_MSEC(APP_SLEEP_MSECS));
			continue;
		}

		prepare_fds(client);
#ifdef CONFIG_MODEM_SIM800
		k_sleep(K_SECONDS(5));
#else 
		poll_when_transport_avail(3000);
#endif
		mqtt_input(client);

		if (!connected) {
			mqtt_abort(client);
		}
	}

	if (connected) {
		return 0;
	}

	return -EINVAL;
}

static int process_mqtt_and_sleep(struct mqtt_client *client, int timeout)
{
	s64_t remaining = timeout;
	s64_t start_time = k_uptime_get();
	int rc;

	while (remaining > 0 && connected) {
#ifndef CONFIG_MODEM_SIM800
		poll_when_transport_avail(remaining);
#endif
		rc = mqtt_input(client);
		if (rc != 0) {
			PRINT_RESULT("mqtt_input", rc);
			return rc;
		}
#ifdef CONFIG_MODEM_SIM800
		k_yield(); // for SIM800 polling is done in mqtt_input
#endif
		remaining = timeout + start_time - k_uptime_get();
	}

	if (connected) {
		rc = mqtt_live(client);
		if (rc != 0 && rc != -EAGAIN /* Zephyr changed API in v2.2 */) {
			PRINT_RESULT("mqtt_live failed", rc);
			return rc;
		}
	}

	return 0;
}

#define SUCCESS_OR_RETURN(rc) { if (rc != 0) { return rc; } }
#define SUCCESS_OR_BREAK(rc) { if (rc != 0) { return; } }

static bool initialize(const char* client_id)
{
	LOG_INF("initialize mqtt...");
	// get mqtt client id from -->
	return 0 == init_client_id(client_id);
}

static bool process_input()
{
	if (!connected) {
		board_lights.modem_connected(false);
		int rc;

#if defined(CONFIG_MQTT_LIB_TLS)
		rc = tls_init();
		PRINT_RESULT("tls_init", rc);
#endif
		LOG_INF("attempting to connect: ");
		rc = try_to_connect(&client_ctx);
		if (0 != rc) {
			PRINT_RESULT("Unable to connect to MQTT: ", rc);
			return false;
		}
		LOG_INF("Successfully connected to MQTT.");
		// connected here, do subscribe
		if (!mqtt_sub())
			return false;
		board_lights.modem_connected(true);
	}

	return 0 == process_mqtt_and_sleep(&client_ctx, APP_SLEEP_MSECS);
}

static bool publish_msg (char *message)
{
	BUILD_ASSERT(1==MQTT_QOS, "The code expects QoS 1");

	LOG_INF("try to publish mqtt_publish: %s", log_strdup(message));
	const u16_t msg_id = sys_rand32_get(); 
	int rc = publish(&client_ctx, message, msg_id, false);
	PRINT_RESULT("mqtt_publish", rc);
	if (0 != rc)
		return false;

	pub_msg_id = msg_id;
	while (k_sem_take(&sem_puback, K_MSEC(PUB_RETRY_TIMEOUT_MSECS))) {
		LOG_ERR("No ack received for msg id %u, retrying", msg_id);
		rc = publish(&client_ctx, message, msg_id, true);
		PRINT_RESULT("mqtt_publish", rc);
		// If publish failed still wait for a response then
		// try again. So that the duplicate flag stays set. 
	}
	
	return true;
}

static bool set_subscribe_callback(subscribe_cb_t subscribe_cb)
{
	if (!subscribe_cb)
		return false;

	m_subscribe_cb = subscribe_cb;

	return true;
}

const mqtt_publisher_t mqtt_publisher = {
	.initialize = initialize,
	.publish = publish_msg,
	.set_subscribe_callback = set_subscribe_callback,
	.process_input = process_input
};
```

## src/mqtt_publisher.h
```c
#ifndef MQTT_PUBLISHER_H
#define MQTT_PUBLISHER_H
#ifdef __cplusplus
extern "C" {
#endif

#include <stdbool.h>

typedef void (*subscribe_cb_t)(const char *payload);
typedef	struct
{
	bool (*initialize)(const char *client_id);
	bool (*publish)(char *message);
	bool (*set_subscribe_callback)(subscribe_cb_t subscribe_cb);
	bool (*process_input)(void);
} mqtt_publisher_t;

extern const mqtt_publisher_t mqtt_publisher;

#ifdef __cplusplus
}
#endif

#endif /* MQTT_PUBLISHER_H */
```

## src/net_mngr.c
```c
#include <assert.h>

#include <device.h>
#include "net_mngr.h"
#include <logging/log.h>
#include <logging/log_ctrl.h>
#include <power/reboot.h>

#if defined(CONFIG_MODEM_GSM_PPP)
#include <net/ppp.h>
#include <../drivers/modem/modem_context.h>
#elif defined(CONFIG_MODEM_SIM800)
#include <../drivers/modem/simcomm-sim80x.h>
#endif


LOG_MODULE_REGISTER(net_mngr, 3);

#if defined(CONFIG_MODEM_GSM_PPP)
static const char* get_guid ()
{

	BUILD_ASSERT(CONFIG_MODEM_SHELL, 
		"CONFIG_MODEM_SHELL=y required to obtain EMEI");  

	struct modem_context *ctx = modem_context_from_iface_dev(
		device_get_binding(CONFIG_MODEM_GSM_UART_NAME));

	__ASSERT(ctx, "Cannot obtain modem context!");
	__ASSERT(*ctx->data_imei, "EMEI is empty!");

	return ctx->data_imei;
}

static bool is_network_ready ()
{
	BUILD_ASSERT(CONFIG_NET_L2_PPP && CONFIG_NET_SHELL,
		"CONFIG_NET_L2_PPP && CONFIG_NET_SHELL are required.");

	static struct ppp_context *ppp_ctx = NULL;
	if (!ppp_ctx)
		ppp_ctx = net_ppp_context_get(0);

	return ppp_ctx && ppp_ctx->is_network_up;
}

static void restart ()
{
	LOG_PANIC();
	LOG_ERR("Restarting the device to restart networking stack.");
	sys_reboot(SYS_REBOOT_COLD);
	CODE_UNREACHABLE;
}
#elif defined(CONFIG_MODEM_SIM800)
static const char* get_guid()
{
	struct device *modem = device_get_binding(CONFIG_MODEM_SIM80X_NAME);
	__ASSERT(modem, "Cannot find modem!");
	
	struct modem_data *mdm_data = (struct modem_data *) modem->driver_data;
	__ASSERT(modem_data.mdm_imei, "EMEI is empty!");
	return mdm_data->mdm_imei;		
}

static bool is_network_ready ()
{
	return true;
}


static void restart ()
{
	LOG_ERR("Restarting network.");
}
#endif

const net_mngr_t net_mngr = {
	.get_guid = get_guid,
	.is_network_ready = is_network_ready,
	.restart = restart
};
```

## src/net_mngr.h
```c
#ifndef NET_MNGR_H
#define NET_MNGR_H
#include <zephyr/types.h>
#include <stdbool.h>

typedef struct {
	const char* (*get_guid) ();
	bool (*is_network_ready) ();
	void (*restart) ();
} net_mngr_t;

extern const net_mngr_t net_mngr;

#endif
```

## src/uart_mqtt_bridge.c
```c
#include "board_lights.h"
#include <drivers/uart.h>
#include <string.h>
#include <net/buf.h>
#include "uart_mqtt_bridge.h"
#include <zephyr.h>

#define MQTT_MSG_MAX_LEN (255)
#define MESH_MSG_MAX_LEN (255)

static K_FIFO_DEFINE(m_queue_to_mqtt);
static K_THREAD_STACK_DEFINE(uart_to_mqtt_thread_stack, 1024);
static struct k_thread uart_to_mqtt_thread_data;
NET_BUF_POOL_DEFINE(m_buf_pool_uart_to_mqtt, /*cnt*/ 40, /* size */ MESH_MSG_MAX_LEN + 1, 0, NULL);

static K_FIFO_DEFINE(m_queue_to_uart);
static K_THREAD_STACK_DEFINE(mqtt_to_uart_thread_stack, 1024);
static struct k_thread mqtt_to_uart_thread_data;
NET_BUF_POOL_DEFINE(m_buf_pool_mqtt_to_uart, /*cnt*/ 5, /* size */ MQTT_MSG_MAX_LEN + 1, 0, NULL);

static struct device *uart = NULL;
static bool (*m_write_to_mqtt)(char *msg);

static void uart_to_mqtt_thread(void *p1, void *p2, void *p3)
{
	while (1) {
		struct net_buf *buf;
		buf = net_buf_get(&m_queue_to_mqtt, K_FOREVER);
		while (!m_write_to_mqtt || !m_write_to_mqtt(buf->data))
			k_sleep(K_SECONDS(5));
		
		board_lights.blink_mqtt(3);
		net_buf_unref(buf);
		k_yield();
	}
}

static void mqtt_to_uart_thread(void *p1, void *p2, void *p3)
{
	while (1) {
		struct net_buf *buf;
		buf = net_buf_get(&m_queue_to_uart, K_FOREVER);
		printk("Writing to UART: %s\n", buf->data);
		while (*buf->data)
			uart_poll_out(uart, *buf->data++);
		net_buf_unref(buf);
		board_lights.blink_uart(3);
		k_yield();
	}
}

static void uart_isr(struct device *x)
{
	static u16_t rx_len = 0;
	static u8_t rx_buf[MESH_MSG_MAX_LEN + 1];
	u8_t rx_byte;
	struct net_buf *nbuf;

	while (uart_irq_update(uart) && uart_irq_is_pending(uart)) {
		if (!uart_irq_rx_ready(uart))
			return;

		while (uart_fifo_read(uart, &rx_byte, 1)) {
			if (rx_byte != '\n') {
				rx_buf[rx_len] = rx_byte;
				// stop growing the message once max length is reached
				rx_len += (rx_len < MESH_MSG_MAX_LEN ? 1 : 0);
				continue;
			}

			if (0 == rx_len)
				continue;

			rx_buf[rx_len++]=0;

			board_lights.blink_uart(3);

			nbuf = net_buf_alloc(&m_buf_pool_uart_to_mqtt, K_NO_WAIT);
			if (nbuf) {
				net_buf_add_mem(nbuf,rx_buf, rx_len);
				net_buf_put(&m_queue_to_mqtt, nbuf);
			} else {
				printk("No more buffers to MQTT are available!\n");
			}

			nbuf = NULL;
			rx_len=0;
		}
	}
}

static void write_to_uart(const char *msg)
{
	const size_t msg_len = strlen(msg);
	struct net_buf *nbuf = net_buf_alloc(&m_buf_pool_mqtt_to_uart, K_NO_WAIT);
	if (nbuf) {
		net_buf_add_mem(nbuf,msg, msg_len <= MQTT_MSG_MAX_LEN ? msg_len : MQTT_MSG_MAX_LEN);
		net_buf_add_u8(nbuf,0);
		net_buf_put(&m_queue_to_uart, nbuf);
	} else {
		printk("No more buffers to UART are available!\n");
	}
}

static bool start (const char *uart_port,
	bool (*write_to_mqtt)(char *msg))
{
	if (!write_to_mqtt)
		return false;

	m_write_to_mqtt = write_to_mqtt;

	printk("Setting up serial.\n");
	uart = device_get_binding(uart_port);

	if (uart == NULL) {
		printk("Device not found: %s\n", uart_port);
		return false;
	}

	printk("uart device found, configuring...\n");
	uart_irq_rx_disable(uart);
	uart_irq_tx_disable(uart);

	// setting
	uart_irq_callback_set(uart, uart_isr);
	printk("\t - set uart callback\n");

	uart_irq_rx_enable(uart);
	printk("\t - enable RX\n");

	k_thread_create(&uart_to_mqtt_thread_data, uart_to_mqtt_thread_stack,
		K_THREAD_STACK_SIZEOF(uart_to_mqtt_thread_stack), uart_to_mqtt_thread,
		NULL, NULL, NULL, K_PRIO_COOP(7), 0, K_NO_WAIT);

	k_thread_create(&mqtt_to_uart_thread_data, mqtt_to_uart_thread_stack,
		K_THREAD_STACK_SIZEOF(mqtt_to_uart_thread_stack), mqtt_to_uart_thread,
		NULL, NULL, NULL, K_PRIO_COOP(8), 0, K_NO_WAIT);

	return true;
}

const uart_mqtt_bridge_t uart_mqtt_bridge = {
	.start = start,
	.write_to_uart = write_to_uart
};
```

## src/uart_mqtt_bridge.h
```c
#ifndef UART_MQTT_BRIDGE_H
#define UART_MQTT_BRIDGE_H
#include <stdbool.h>

typedef	struct {
	bool (*start)(const char *uart_port,
		bool (*write_to_mqtt)(char *msg));

	void (*write_to_uart)(const char *msg);
} uart_mqtt_bridge_t;

extern const uart_mqtt_bridge_t uart_mqtt_bridge;

#endif
```
