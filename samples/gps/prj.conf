## CMakeLists.txt
```
# SPDX-License-Identifier: Apache-2.0

cmake_minimum_required(VERSION 3.13.1)

include($ENV{ZEPHYR_BASE}/cmake/app/boilerplate.cmake NO_POLICY_SCOPE)
project(gps)

target_sources(app PRIVATE src/main.c)
```

## prj.conf
```kconfig
# Enable support for the SIM module. 
CONFIG_MODEM=y
CONFIG_MODEM_SHELL=y
CONFIG_SIM80X_LIB=y
CONFIG_MODEM_SIM800=y
CONFIG_MODEM_IFACE_UART=y
CONFIG_MODEM_LOG_LEVEL_DBG=y
CONFIG_MODEM_CONTEXT_VERBOSE_DEBUG=y
```

## src/main.c
```c
/*
 * Copyright (c) 2012-2014 Wind River Systems, Inc.
 *
 * SPDX-License-Identifier: Apache-2.0
 */

#include <zephyr.h>
#include <sys/printk.h>

/* TODO: This needs to be fixed. OK for now. */
#include "../../../../ext/lib/gps_nmea_parser/include/gps/gps.h"

extern void SIM80x_Get_GPS(gps_t *gps);

void main(void)
{
	gps_t gps;

    while (1)
    {
    	/* Get GPS. */
		SIM80x_Get_GPS(&gps);
		printk("Latitude: %d", (int)gps.latitude);
		printk("Longitude: %d", (int)gps.longitude);

		/* sleep.. */
		k_sleep(100);
    }
}
```
