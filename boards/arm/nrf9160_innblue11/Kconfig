## boards/arm/nrf9160_innblue11/Kconfig.board
```kconfig
# Kconfig - nRF9160 innblue v1.1 board configuration
#
# 2018, 2019, 2020 by innblue
#

if SOC_NRF9160_SICA

config BOARD_NRF9160_INNBLUE11
	bool "nRF9160 innblue v11"
	depends on !TRUSTED_EXECUTION_NONSECURE

config BOARD_NRF9160_INNBLUE11NS
	bool "nRF9160 innblue v11 non-secure"
	depends on TRUSTED_EXECUTION_NONSECURE

endif # SOC_NRF9160_SICA
```

## boards/arm/nrf9160_innblue22/Kconfig.board
```kconfig
# nRF9160 innblue V2.2 board configuration

# Copyright (c) 2020 InnBlue
# SPDX-License-Identifier: Apache-2.0

if SOC_NRF9160_SICA

config BOARD_NRF9160_INNBLUE22
	bool "nRF9160 innblue v22"
	depends on !TRUSTED_EXECUTION_NONSECURE

config BOARD_NRF9160_INNBLUE22NS
	bool "nRF9160 innblue v22 non-secure"
	depends on TRUSTED_EXECUTION_NONSECURE

endif # SOC_NRF9160_SICA
```

## boards/arm/skyygate_sim800/Kconfig.board
```kconfig
# InnBlue Skyygate SIM800 board configuration

# Copyright (c) 2020 InnBlue
# SPDX-License-Identifier: Apache-2.0

config BOARD_SKYYGATE_SIM800
	bool "InnBlue Skyygate SIM800 board"
	depends on SOC_STM32L475XX
```

## boards/arm/skyygate_sim800/Kconfig.defconfig
```kconfig
# InnBlue Skyygate SIM800 configuration

# Copyright (c) 2020 InnBlue Limited
# SPDX-License-Identifier: Apache-2.0

if BOARD_SKYYGATE_SIM800

config BOARD
	default "skyygate_sim800"

if STM32_LPTIM_TIMER

choice STM32_LPTIM_CLOCK
	default STM32_LPTIM_CLOCK_LSE

endchoice

endif #STM32_LPTIM_TIMER

if SPI

config SPI_STM32_INTERRUPT
	default y

config SPI_3
	default y

endif # SPI

if I2C

config I2C_2
	default y

endif # I2C

if MODEM_SIM800

config UART_2
	default y

endif #MODEM_SIM800

if BT

config SPI
	default y

choice BT_HCI_BUS_TYPE
	default BT_SPI
endchoice

# Disable Flow control
config BT_HCI_ACL_FLOW_CONTROL
	default n
config BT_HCI_VS_EXT
	default n

endif #BT

endif #BOARD_SKYYGATE_SIM800
```

## boards/arm/skyygate_sim868/Kconfig.board
```kconfig
# InnBlue Skyygate SIM868 board configuration

# Copyright (c) 2020 InnBlue
# SPDX-License-Identifier: Apache-2.0

config BOARD_SKYYGATE_SIM868
	bool "InnBlue Skyygate SIM868 board"
	depends on SOC_STM32L475XX

config MODEM_MINIMUM_RSSI
	int "Minimum RSSI"
	range 0 99
	default 10
	depends on BOARD_SKYYGATE_SIM868 && (MODEM_GSM_PPP || MODEM_SIM800)
	help 
		The minimum RSSI to be measured by GSM modem before the network is initialized.
		The network won't be started until the RSSI is reached. For details see AT+CSQ
		modem command.
```

## boards/arm/skyygate_sim868/Kconfig.defconfig
```kconfig
# InnBlue Skyygate SIM868 configuration

# Copyright (c) 2020 InnBlue Limited
# SPDX-License-Identifier: Apache-2.0

if BOARD_SKYYGATE_SIM868

config BOARD
	default "skyygate_sim868"

if STM32_LPTIM_TIMER

choice STM32_LPTIM_CLOCK
	default STM32_LPTIM_CLOCK_LSE

endchoice

endif #STM32_LPTIM_TIMER

if UART_CONSOLE

config UART_1
	default y

endif # UART_CONSOLE

if SPI

config SPI_STM32_INTERRUPT
	default y

config SPI_3
	default y

endif # SPI

if I2C

config I2C_2
	default y

endif # I2C

if MODEM_SIM800

config UART_2
	default y

endif #MODEM_SIM800

if BT

config SPI
	default y

choice BT_HCI_BUS_TYPE
	default BT_SPI
endchoice

# Disable Flow control
config BT_HCI_ACL_FLOW_CONTROL
	default n
config BT_HCI_VS_EXT
	default n

endif #BT

endif #BOARD_SKYYGATE_SIM868
```

## boards/arm/skyygate_sim868/skyygate_sim868_defconfig
```kconfig
# SPDX-License-Identifier: Apache-2.0

CONFIG_BOARD_SKYYGATE_SIM868=y
CONFIG_SOC_SERIES_STM32L4X=y
CONFIG_SOC_STM32L475XX=y
# 80MHz system clock
CONFIG_SYS_CLOCK_HW_CYCLES_PER_SEC=80000000

# enable uart driver
CONFIG_SERIAL=y
CONFIG_UART_INTERRUPT_DRIVEN=y

# enable pinmux
CONFIG_PINMUX=y

# enable GPIO
CONFIG_GPIO=y

# clock configuration
CONFIG_CLOCK_CONTROL=y
CONFIG_CLOCK_STM32_SYSCLK_SRC_PLL=y
# use HSI as PLL input
CONFIG_CLOCK_STM32_PLL_SRC_HSI=y

# produce 80MHz clock at PLL output
CONFIG_CLOCK_STM32_PLL_M_DIVISOR=1
CONFIG_CLOCK_STM32_PLL_N_MULTIPLIER=20
CONFIG_CLOCK_STM32_PLL_P_DIVISOR=7
CONFIG_CLOCK_STM32_PLL_Q_DIVISOR=2
CONFIG_CLOCK_STM32_PLL_R_DIVISOR=4

# Configure bus clocks
CONFIG_CLOCK_STM32_AHB_PRESCALER=1
CONFIG_CLOCK_STM32_APB1_PRESCALER=1
CONFIG_CLOCK_STM32_APB2_PRESCALER=1

# LSE oscillator is populated, enable MSI PLL-Mode
CONFIG_CLOCK_STM32_LSE=y
CONFIG_CLOCK_STM32_MSI_PLL_MODE=y

# enable MPU
CONFIG_ARM_MPU=y

# console
CONFIG_CONSOLE=y
CONFIG_UART_CONSOLE=y

# GSM modem support
CONFIG_UART_2=y
CONFIG_MODEM=y
CONFIG_MODEM_GSM_PPP=y
CONFIG_MODEM_GSM_UART_NAME="UART_2"

# PPP networking support
CONFIG_NET_PPP=y
CONFIG_NET_L2_PPP=y
CONFIG_NET_NATIVE=y
CONFIG_NETWORKING=y
CONFIG_NET_L2_PPP_TIMEOUT=10000

# IPv4 enables PPP IPCP support
CONFIG_NET_IPV4=y
CONFIG_NET_IPV6=n

# Network management events
CONFIG_NET_CONNECTION_MANAGER=y

# Log buffers, modem and PPP
CONFIG_LOG=y
CONFIG_NET_LOG=y
#CONFIG_LOG_BUFFER_SIZE=16384
#CONFIG_LOG_STRDUP_BUF_COUNT=200
#CONFIG_MODEM_LOG_LEVEL_DBG=y
#CONFIG_NET_PPP_LOG_LEVEL_DBG=y
#CONFIG_NET_L2_PPP_LOG_LEVEL_DBG=y
#CONFIG_NET_MGMT_EVENT_LOG_LEVEL_DBG=y
#CONFIG_NET_CONNECTION_MANAGER_LOG_LEVEL_DBG=y

CONFIG_NET_SHELL=y
CONFIG_MODEM_SHELL=y

# need this? OK TO REMOVE
#CONFIG_NO_OPTIMIZATIONS=y
```

## boards/arm/ublox_c030_r412/Kconfig.board
```kconfig
# U-Blox C030-R412 board configuration

# Copyright (c) 2017 Linaro Limited
# SPDX-License-Identifier: Apache-2.0

config BOARD_UBLOX_C030_R412
	bool "U-Blox C030-R412 IoT Starter Kit"
	depends on SOC_STM32F437XX
```

## boards/arm/ublox_c030_r412/Kconfig.defconfig
```kconfig
# Discovery IoT L475 board configuration

# Copyright (c) 2017 Linaro Limited
# SPDX-License-Identifier: Apache-2.0

if BOARD_UBLOX_C030_R412

config BOARD
	default "ublox_c030_r412"

if UART_CONSOLE

config UART_2
	default y

endif # UART_CONSOLE

if MODEM

config UART_1
	default y

config MODEM_UBLOX_SARA
	default y

choice MODEM_UBLOX_SARA_VARIANT
	default MODEM_UBLOX_SARA_R4
endchoice

config UART_INTERRUPT_DRIVEN
	default y

endif # MODEM

endif # BOARD_UBLOX_C030_R412
```

## boards/arm/ublox_c030_r412/ublox_c030_r412_defconfig
```kconfig
# SPDX-License-Identifier: Apache-2.0

CONFIG_ARM=y
CONFIG_BOARD_UBLOX_C030_R412=y
CONFIG_SOC_SERIES_STM32F4X=y
CONFIG_SOC_STM32F437XX=y
CONFIG_CORTEX_M_SYSTICK=y

# 80MHz system clock
CONFIG_SYS_CLOCK_HW_CYCLES_PER_SEC=80000000

# enable uart driver
CONFIG_SERIAL=y
CONFIG_UART_INTERRUPT_DRIVEN=y

# enable pinmux
CONFIG_PINMUX=y

# enable GPIO
CONFIG_GPIO=y

# console
CONFIG_CONSOLE=y
CONFIG_UART_CONSOLE=y

# enable Modem. 
CONFIG_MODEM=y
CONFIG_MODEM_SHELL=y
CONFIG_MODEM_UBLOX_SARA=y
CONFIG_MODEM_IFACE_UART=y
CONFIG_MODEM_LOG_LEVEL_DBG=y
CONFIG_MODEM_CONTEXT_VERBOSE_DEBUG=y

# enable MPU
CONFIG_ARM_MPU=y

# clock configuration
CONFIG_CLOCK_CONTROL=y

# Clock configuration for Cube Clock control driver
CONFIG_CLOCK_STM32_SYSCLK_SRC_PLL=y
CONFIG_CLOCK_STM32_PLL_SRC_HSI=y

# clock at PLL output
CONFIG_CLOCK_STM32_PLL_M_DIVISOR=16
CONFIG_CLOCK_STM32_PLL_N_MULTIPLIER=336
CONFIG_CLOCK_STM32_PLL_P_DIVISOR=2
CONFIG_CLOCK_STM32_PLL_Q_DIVISOR=7
CONFIG_CLOCK_STM32_AHB_PRESCALER=1
CONFIG_CLOCK_STM32_APB1_PRESCALER=4
CONFIG_CLOCK_STM32_APB2_PRESCALER=2

# enable Networking and Socket offload
CONFIG_NETWORKING=y
CONFIG_NET_SOCKETS=y
CONFIG_NET_TCP=y
CONFIG_NET_LOG=y
CONFIG_NET_IPV4=y
CONFIG_NET_SHELL=y
CONFIG_EARLY_CONSOLE=y
CONFIG_NETWORKING=y
CONFIG_TEST_RANDOM_GENERATOR=y
CONFIG_NET_TX_STACK_SIZE=2048
CONFIG_NET_RX_STACK_SIZE=2048
CONFIG_NET_PKT_RX_COUNT=10
CONFIG_NET_PKT_TX_COUNT=10
CONFIG_NET_BUF_RX_COUNT=20
CONFIG_NET_BUF_TX_COUNT=20
CONFIG_NET_MAX_CONTEXTS=10
CONFIG_NET_IPV4=y
CONFIG_NET_IPV6=n
CONFIG_NET_SOCKETS_OFFLOAD=y
CONFIG_NET_SOCKETS=y
```

## boards/arm/ublox_c030_u201/Kconfig.board
```kconfig
# U-Blox C030-U201 board configuration

# Copyright (c) 2017 Linaro Limited
# SPDX-License-Identifier: Apache-2.0

config BOARD_UBLOX_C030_U201
	bool "U-Blox C030-U201 IoT Starter Kit"
	depends on SOC_STM32F437XX
```

## boards/arm/ublox_c030_u201/Kconfig.defconfig
```kconfig
# Discovery IoT L475 board configuration

# Copyright (c) 2017 Linaro Limited
# SPDX-License-Identifier: Apache-2.0

if BOARD_UBLOX_C030_U201

config BOARD
	default "ublox_c030_u201"

if UART_CONSOLE

config UART_1
	default y

endif # UART_CONSOLE

endif # BOARD_UBLOX_C030_U201
```

## drivers/modem/Kconfig.simcomm-sim800
```kconfig
# u-blox SARA R4 driver options

# Copyright (c) 2019 Foundries.io
# SPDX-License-Identifier: Apache-2.0

config MODEM_SIM800
	bool "Enable SIMCOMM SIM800 modem driver"
	select MODEM_CONTEXT
	select MODEM_CMD_HANDLER
	select MODEM_IFACE_UART
	select MODEM_SOCKET
	select NET_OFFLOAD
	select NET_SOCKETS_OFFLOAD
	imply GPIO
	help
	  Choose this setting to enable SIMCOMM SIM800 modem
	  driver.

if MODEM_SIM800

config MODEM_SIM80X_NAME
	string "Driver name"
	default "MODEM_SIM80X"

config MODEM_SIM80X_APN
	string "Name of access point to connect with"
	default "iot.1nce.net"

config MODEM_SIM80X_INIT_PRIORITY
	int "SIMCOMM SIM80X driver init priority"
	default 50
	help
	  SIMCOMM SIM80X device driver initialization priority.
	  Do not mess with it unless you know what you are doing.
	  Note that the priority needs to be lower than the net stack
	  so that it can start before the networking sub-system.

endif # MODEM_SIM800
```

## drivers/sensor/bq274xx/Kconfig
```kconfig
menuconfig BQ274XX
	bool "BQ274xx Fuel Gauge"
	depends on (I2C && HAS_DTS_I2C)
	help	
	  Enable I2C-based driver for BQ274xx Fuel Gauge.

if BQ274XX

config BQ274XX_DESIGN_VOLTAGE
	int "Battery Design Volatge in mV"
	range 3300 4400
	default 3700
	help 
	  Specify the design voltage of the battery

config BQ274XX_DESIGN_CAPACITY
	int "Battery Design Capacity in mAh"
	default 1800

config BQ274XX_TAPER_CURRENT
	int "Battery Taper current in mAh"
	default 45

config BQ274XX_TERMINATE_VOLTAGE
	int "Battery Terminate Voltage in mV"
	default 3000

endif # BQ274XX
```

## dts/bindings/modem/simcomm,sim80x.yaml
```yaml
# Copyright (c) 2019, Foundries.io
# SPDX-License-Identifier: Apache-2.0

title: SIMCOMM SIM80x modem

description: |
    This is a representation of the SIMCOMM SIM800/SIM808 modem.

compatible: "simcomm,sim80x"

include: uart-device.yaml

properties:
    label:
      required: true

    mdm-reset-gpios:
      type: phandle-array
      required: true
```

## dts/bindings/sensor/ti,bq274xx.yaml
```yaml
#
# Copyright (c) 2019, Linumiz
#
# SPDX-License-Identifier: Apache-2.0
#

description: Texas Instruments BQ274xx Fuel Gauge

compatible: "ti,bq274xx"

include: i2c-device.yaml
```

## ext/Kconfig
```kconfig
# External source code configuration options

# Copyright (c) 2016 Linaro Ltd.
# SPDX-License-Identifier: Apache-2.0

menu "External Sources"

source "ext/hal/Kconfig"

source "ext/lib/crypto/Kconfig"

source "ext/lib/fnmatch/Kconfig"

source "ext/lib/attentive/Kconfig"

source "ext/lib/gps_nmea_parser/Kconfig"

endmenu
```

## ext/lib/attentive/Kconfig
```kconfig
# Copyright (c) 2018 Nordic Semiconductor
# SPDX-License-Identifier: Apache-2.0

config SIM80X_LIB
	bool "SIM80x Modem Support"
	help
	  This option enables the support for SIM80x
```

## lib/gps_nmea_parser/Kconfig
```kconfig
# Copyright (c) 2018 Nordic Semiconductor
# SPDX-License-Identifier: Apache-2.0

config GPS_NMEA_LIB
	bool "GPS NMEA Lib Support"
	help
	  This option enables the support for GPS NMEA Library
```

## subsys/net/lib/tftp/Kconfig
```kconfig
# Socket MQTT Library for Zephyr

# Copyright (c) 2018 Nordic Semiconductor ASA
# SPDX-License-Identifier: Apache-2.0

config TFTP_LIB
    bool "Socket TFTP Library Support"
    select NET_SOCKETS
    select NET_SOCKETS_POSIX_NAMES
    help
      Enable the Zephyr TFTP Library

if TFTP_LIB

module=TFTP
module-dep=NET_LOG
module-str=Log level for TFTP
module-help=Enables tftp debug messages.
source "subsys/net/Kconfig.template.log_config.net"

config TFTPC_MAX_FILENAME_SIZE
    int "Maximum size of the filename that we can get / put to the TFTP Server."
    default 10
    help
      Maximum size (defined in the number of characters) of each filename that we 
      can get or put to the TFTP Server. This is introduced to allow the user to scale up
      the size of request array that is not dynamically created (as we don't like dynamic 
      memory allocations).
      
config TFTPC_REQUEST_TIMEOUT
    int "Maximum amount of time the TFTP Client will wait for a response from the server."
    default 5
    help
      Maximum amount of time (in seconds) that the TFTP Client will wait for data from the 
      TFTP Server. Once this time has elasped, the TFTP Client will assume that the Server 
      failed and close the connection.
      
config TFTPC_REQUEST_RETRANSMITS
    int "Number of times the TFTP Client will retransmit the request and expect data from the server."
    default 5
    help
      Once the TFTP Client sends out a request, it will wait TFTPC_REQUEST_TIMEOUT secs for the data 
      to arrive from the TFTP Server. However, if it doesn't arrive within the given time we will 
      re-transmit the request to the server in hopes that the server will respond within time to this 
      request. This number dictates the number of times we will do re-tx of our request before giving up
      and exiting. 
      
endif # TFTP_LIB
```
